## Config.in
```kconfig
# Configuration for Buildroot integration
source "$BR2_EXTERNAL_OPENTRONS_MONOREPO_PATH/api/Config.in"
source "$BR2_EXTERNAL_OPENTRONS_MONOREPO_PATH/update-server/Config.in"
source "$BR2_EXTERNAL_OPENTRONS_MONOREPO_PATH/robot-server/Config.in"
source "$BR2_EXTERNAL_OPENTRONS_MONOREPO_PATH/shared-data/python/Config.in"
source "$BR2_EXTERNAL_OPENTRONS_MONOREPO_PATH/notify-server/Config.in"
source "$BR2_EXTERNAL_OPENTRONS_MONOREPO_PATH/system-server/Config.in"
source "$BR2_EXTERNAL_OPENTRONS_MONOREPO_PATH/server-utils/Config.in"
source "$BR2_EXTERNAL_OPENTRONS_MONOREPO_PATH/hardware/Config.in"
```

## api/Config.in
```kconfig
config BR2_PACKAGE_PYTHON_OPENTRONS_API
  bool "python-opentrons-api"
  depends on BR2_PACKAGE_PYTHON3
  select BR2_PACKAGE_PYTHON_AIONOTIFY # runtime
  select BR2_PACKAGE_PYTHON_ANYIO # runtime
  select BR2_PACKAGE_PYTHON_JSONSCHEMA # runtime
  select BR2_PACKAGE_PYTHON_NUMPY # runtime
  select BR2_PACKAGE_PYTHON_PYDANTIC # runtime
  select BR2_PACKAGE_PYTHON_SERIAL # runtime
  select BR2_PACKAGE_PYTHON_SYSTEMD # runtime
  select BR2_PACKAGE_PYTHON_TYPING_EXTENSIONS # runtime

  help
    Opentrons API library. Used on an OT-2 robot.

    https://opentrons.com
```

## hardware/Config.in
```kconfig
config BR2_PACKAGE_PYTHON_OPENTRONS_HARDWARE
  bool "python-opentrons-hardware"
  depends on BR2_PACKAGE_PYTHON3
  select BR2_PACKAGE_PYTHON_AIONOTIFY # runtime
  select BR2_PACKAGE_PYTHON_ANYIO # runtime
  select BR2_PACKAGE_PYTHON_JSONSCHEMA # runtime
  select BR2_PACKAGE_PYTHON_NUMPY # runtime
  select BR2_PACKAGE_PYTHON_PYDANTIC # runtime
  select BR2_PACKAGE_PYTHON_SERIAL # runtime
  select BR2_PACKAGE_PYTHON_SYSTEMD # runtime
  select BR2_PACKAGE_PYTHON_TYPING_EXTENSIONS # runtime
  select BR2_PACKAGE_PYTHON_CLICK # runtime

  help
    Opentrons hardware package. Provides an interface for OT-2 and Flex control.

    https://opentrons.com
```

## notify-server/Config.in
```kconfig
config BR2_PACKAGE_PYTHON_OPENTRONS_NOTIFY_SERVER
  bool "python-opentrons-notify-server"
  depends on BR2_PACKAGE_PYTHON3
  select BR2_PACKAGE_PYTHON_OPENTRONS_API # runtime
  select BR2_PACKAGE_PYTHON_OPENTRONS_SHARED_DATA # runtime
  select BR2_PACKAGE_PYTHON_PYDANTIC # runtime
  select BR2_PACKAGE_PYTHON_PYZMQ # runtime
  select BR2_PACKAGE_PYTHON_TYPING_EXTENSIONS # runtime

  help
    Opentrons notification server for OT2 robot.

    https://opentrons.com
```

## robot-server/Config.in
```kconfig
config BR2_PACKAGE_PYTHON_OPENTRONS_ROBOT_SERVER
  bool "python-opentrons-robot-server"
  depends on BR2_PACKAGE_PYTHON3
  select BR2_PACKAGE_PYTHON_OPENTRONS_API # runtime
  select BR2_PACKAGE_PYTHON_FASTAPI # runtime
  select BR2_PACKAGE_PYTHON_UVICORN # runtime
  select BR2_PACKAGE_PYTHON_MULTIPART # runtime
  select BR2_PACKAGE_PYTHON_DOTENV # runtime
  help
    Opentrons HTTP server. Controls an OT2 robot.

    https://opentrons.com
```

## server-utils/Config.in
```kconfig
config BR2_PACKAGE_PYTHON_OPENTRONS_SERVER_UTILS
  bool "python-opentrons-system-server"
  depends on BR2_PACKAGE_PYTHON3
  select BR2_PACKAGE_PYTHON_ANYIO # runtime
  select BR2_PACKAGE_PYTHON_FASTAPI # runtime
  select BR2_PACKAGE_PYTHON_DOTENV # runtime
  select BR2_PACKAGE_PYTHON_MULTIPART # runtime
  select BR2_PACKAGE_PYTHON_PYDANTIC # runtime
  select BR2_PACKAGE_PYTHON_SQLALCHEMY # runtime
  select BR2_PACKAGE_PYTHON_TYPING_EXTENSIONS # runtime
  select BR2_PACKAGE_PYTHON_UVICORN # runtime
  select BR2_PACKAGE_PYTHON_WSPROTO # runtime

  help
    Opentrons HTTP server common utils.

    https://opentrons.com
```

## system-server/Config.in
```kconfig
config BR2_PACKAGE_PYTHON_OPENTRONS_SYSTEM_SERVER
  bool "python-opentrons-system-server"
  depends on BR2_PACKAGE_PYTHON3
  select BR2_PACKAGE_PYTHON_TYPING_EXTENSIONS # runtime
  select BR2_PACKAGE_PYTHON_PYJWT # runtime
  select BR2_PACKAGE_PYTHON_OPENTRONS_SERVER_UTILS # runtime

  help
    Opentrons system HTTP server. Provides access to an OT-2 robot.

    https://opentrons.com
```
